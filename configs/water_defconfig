## configs/water_defconfig
```kconfig
CONFIG_LINUX_KRNL_HEADER_IMG=y
CONFIG_COMPRESS_GZIP=y
CONFIG_SIMPLE_FB=y
CONFIG_MT6765=y
CONFIG_XIAOMI_WATER=y
CONFIG_TEXT_BASE=0x40080000
CONFIG_RAMDISK_ENTRY=0x51b00000
CONFIG_PAYLOAD_ENTRY=0x60000000
```
